## kernel-4.14/drivers/input/touchscreen/mediatek/ili9882n/Kconfig
```kconfig
#
# Touchscreen driver configuration
#
config TOUCHSCREEN_MTK_ILI9882N
    bool "ili9882n Touchscreen"
    default n
    help
      Say Y here if you have ili9882n touch panel.
      If unsure, say N.
 
```

## kernel-4.14/drivers/misc/mediatek/sensors-1.0/accelerometer/icm426xx_acc/Kconfig
```kconfig
config MTK_ICM426XX_ACC
        bool "ICM426XX for MediaTek package"
        default n
        help
        It support different accelerometer sensor.
        If this option is set,
            it will support
            ICM426XX accelerometer.
```

## kernel-4.14/drivers/misc/mediatek/sensors-1.0/alsps/stk3332_auto/Kconfig
```kconfig
config MTK_STK3X1X_BIRD_C
	bool "stk3x1x for MediaTek package"
	default n
	help
	It support different type sensor
	in this platform. If this option
	is set, it will support ambient
	and light sensor STK3X1X.
```
